## samples/exeggutorch/sample.yaml
```yaml
sample:
  description: ExecuTorch inference on RISC-V with XNNPack backend (lowering flow testbed)
  name: exeggutorch
common:
  tags: introduction
  integration_platforms:
    - spike_riscv64
  harness: console
  harness_config:
    type: one_line
```
